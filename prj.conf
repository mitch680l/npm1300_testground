## CMakeLists.txt
```
cmake_minimum_required(VERSION 3.20.0)
find_package(Zephyr REQUIRED HINTS $ENV{ZEPHYR_BASE})

project(npm1300_test)

target_sources(app PRIVATE src/main.c)
target_sources(app PRIVATE src/npm1300_startup.c)
target_sources(app PRIVATE src/gnss.c)
target_sources(app PRIVATE src/config.c)
```

## sysbuild.conf
```
SB_CONFIG_BOOTLOADER_MCUBOOT=n
SB_CONFIG_KESTREL_NO_PREDEFINED_LAYOUT=y
```

## prj.conf
```kconfig
# System
CONFIG_REBOOT=y

# Logging
CONFIG_LOG=y
CONFIG_LOG_PRINTK=y
CONFIG_LOG_CMDS=y
CONFIG_LOG_DEFAULT_LEVEL=3
# Enable log colors
CONFIG_LOG_BACKEND_SHOW_COLOR=y


CONFIG_SERIAL=y
CONFIG_GPIO=y
CONFIG_I2C_GPIO=y

# Peripherals
CONFIG_DK_LIBRARY=y
CONFIG_I2C=y


# Newlib
CONFIG_NEWLIB_LIBC=y
CONFIG_FPU=y
CONFIG_NEWLIB_LIBC_FLOAT_PRINTF=y

# Networking
CONFIG_NETWORKING=y
CONFIG_NET_NATIVE=n
CONFIG_NET_SOCKETS_OFFLOAD=y
CONFIG_NET_SOCKETS=y
CONFIG_POSIX_API=y

# Memory
CONFIG_THREAD_ANALYZER=y


# Modem library
CONFIG_NRF_MODEM_LIB=y
CONFIG_MODEM_KEY_MGMT=y
CONFIG_MODEM_INFO=y
CONFIG_MODEM_INFO_ADD_NETWORK=y
CONFIG_MODEM_INFO_ADD_SIM=y
CONFIG_MODEM_INFO_ADD_SIM_IMSI=y
CONFIG_MODEM_INFO_ADD_SIM_ICCID=y
CONFIG_MODEM_INFO_ADD_DEVICE=y
CONFIG_MODEM_INFO_ADD_DATE_TIME=n

# LTE link control
CONFIG_LTE_LINK_CONTROL=y
CONFIG_LTE_NETWORK_MODE_LTE_M_NBIOT_GPS=y
CONFIG_LTE_LC_EDRX_MODULE=n
CONFIG_LTE_LC_PSM_MODULE=y
CONFIG_LTE_LINK_CONTROL=y
CONFIG_LTE_NETWORK_MODE_DEFAULT=y
CONFIG_LTE_LC_MODEM_SLEEP_NOTIFICATIONS=n
CONFIG_LTE_LC_TAU_PRE_WARNING_NOTIFICATIONS=n
CONFIG_LTE_LC_TAU_PRE_WARNING_THRESHOLD_MS=10240
CONFIG_LTE_LC_MODEM_SLEEP_NOTIFICATIONS_THRESHOLD_MS=10240
CONFIG_LTE_NEIGHBOR_CELLS_MAX=17
CONFIG_LTE_LC_CONN_EVAL_MODULE=y
CONFIG_LTE_LC_EDRX_MODULE=y
CONFIG_LTE_LC_NEIGHBOR_CELL_MEAS_MODULE=y
CONFIG_LTE_LC_PERIODIC_SEARCH_MODULE=y
CONFIG_LTE_LC_PSM_MODULE=y
CONFIG_LTE_LC_RAI_MODULE=y
CONFIG_LTE_LC_MODEM_SLEEP_MODULE=y
CONFIG_LTE_LC_TAU_PRE_WARNING_MODULE=y

# AT commands interface
CONFIG_AT_HOST_LIBRARY=n
CONFIG_UART_INTERRUPT_DRIVEN=y
CONFIG_SHELL_WILDCARD=y
# MQTT
# Enable and configure the MQTT library
CONFIG_MQTT_LIB=y
CONFIG_MQTT_CLEAN_SESSION=y

# Core settings API
CONFIG_SETTINGS=y

# Shell & logging on your existing console

CONFIG_DK_LIBRARY=y
CONFIG_GPIO=y
CONFIG_SENSOR=y
CONFIG_NRF_MODEM_LIB=y
CONFIG_NET_PKT_RX_COUNT=4
CONFIG_NET_BUF_RX_COUNT=8
CONFIG_NET_BUF_DATA_SIZE=256

CONFIG_MAIN_STACK_SIZE=8192
#CONFIG_LOG_BUFFER_SIZE=6000
CONFIG_HEAP_MEM_POOL_SIZE=40000  
CONFIG_SHELL_STACK_SIZE=6096
CONFIG_SHELL_ARGC_MAX=70
CONFIG_SHELL_CMD_BUFF_SIZE=2524
CONFIG_SYSTEM_WORKQUEUE_STACK_SIZE=8096
CONFIG_MBEDTLS_HEAP_SIZE=1500
CONFIG_LOG_BUFFER_SIZE=4096        
CONFIG_LOG_PROCESS_THREAD=y
CONFIG_LOG_PROCESS_THREAD_STACK_SIZE=2048

#TLS
CONFIG_NETWORKING=y
CONFIG_NET_NATIVE=n
CONFIG_NET_SOCKETS_OFFLOAD=y
# Enable TLS support in Zephyr sockets
CONFIG_NET_SOCKETS=y
CONFIG_MQTT_LIB_TLS=y
# Enable MbedTLS for TLS
CONFIG_MBEDTLS=y
CONFIG_MBEDTLS_ENABLE_HEAP=y
# Enable modem TLS credential storage
CONFIG_MODEM_KEY_MGMT=y

#crypto
# Enable PSA Crypto core
CONFIG_NRF_SECURITY=y
CONFIG_BUILD_WITH_TFM=y
CONFIG_MBEDTLS_PSA_CRYPTO_C=y
CONFIG_PSA_WANT_GENERATE_RANDOM=y
CONFIG_PSA_WANT_KEY_TYPE_AES=y
CONFIG_PSA_WANT_ALG_GCM=y
CONFIG_TFM_PROFILE_TYPE_NOT_SET=y
CONFIG_PSA_CRYPTO_DRIVER_CC3XX=y
CONFIG_PM_PARTITION_SIZE_TFM_SRAM=0x10000
CONFIG_BOOTLOADER_MCUBOOT=y
CONFIG_MBEDTLS_PSA_CRYPTO_STORAGE_C=y
CONFIG_TFM_ITS_ENCRYPTED=y
CONFIG_PSA_WANT_ALG_PBKDF2_HMAC=y
CONFIG_PSA_WANT_ALG_SHA3_256=y
CONFIG_PSA_WANT_KEY_TYPE_PASSWORD=y
CONFIG_PSA_WANT_ALG_HMAC=y


CONFIG_SHELL_STACK_SIZE=6096
CONFIG_SHELL=y
CONFIG_SHELL_CMDS=y
CONFIG_SHELL_DEVICE_HELPERS=n
CONFIG_SHELL=y
CONFIG_SHELL_BACKEND_SERIAL=y   # use the existing console UART/USB-CDC
CONFIG_SHELL_LOG_BACKEND=y      # pipe LOG_* into the shell prompt
CONFIG_UART_INTERRUPT_DRIVEN=y  # required by the shell’s serial backend
CONFIG_SHELL_PROMPT_UART="x"
CONFIG_NEWLIB_LIBC=y
CONFIG_DATE_SHELL=n
CONFIG_DEVICE_SHELL=y
CONFIG_DEVMEM_SHELL=y
CONFIG_KERNEL_SHELL=y
CONFIG_I2C_SHELL=y
CONFIG_SHELL_BACKEND_SERIAL_RX_RING_BUFFER_SIZE=528
CONFIG_SPI=y
CONFIG_SPI_SHELL=y
CONFIG_SENSOR_SHELL=y
CONFIG_AT_SHELL=y



# CONFIG_UART_CONSOLE=n
# CONFIG_SHELL=y
# CONFIG_SHELL_BACKEND_DUMMY=y
# CONFIG_MCUMGR_TRANSPORT_DUMMY=y
# CONFIG_MCUMGR_TRANSPORT_SHELL=y
# CONFIG_SHELL_LOG_BACKEND=n
# CONFIG_SHELL_BACKEND_SERIAL=n

# CONFIG_MCUMGR_LOG_LEVEL_DBG=y
# CONFIG_DOWNLOADER_LOG_LEVEL_DBG=y
# CONFIG_FOTA_DOWNLOAD_LOG_LEVEL_DBG=y
# CONFIG_LTE_LINK_CONTROL_LOG_LEVEL_DBG=y


CONFIG_SENSOR=y
CONFIG_BMP388=y
CONFIG_IIS2MDC=y
CONFIG_ICM42688=y
CONFIG_WATCHDOG=y

CONFIG_PDN=y
CONFIG_PDN_ESM_STRERROR=y
CONFIG_PDN_LOG_LEVEL_INF=y

CONFIG_THREAD_ANALYZER=y
CONFIG_THREAD_ANALYZER_AUTO=y
CONFIG_THREAD_RUNTIME_STATS=y
CONFIG_SYS_HEAP_RUNTIME_STATS=y
CONFIG_SYS_HEAP_AUTO=y
CONFIG_THREAD_NAME=y




CONFIG_RESET_ON_FATAL_ERROR=y
CONFIG_FAULT_DUMP=2
```

## src/main.c
```c
#include <zephyr/kernel.h>
#include "config.h"
#include "gnss.h"
#include <zephyr/debug/thread_analyzer.h>


LOG_MODULE_REGISTER(main, LOG_LEVEL_INF);


int main(void)
{
        gnss_int();

        // Print thread stats after initialization to see peak stack usage
        k_sleep(K_MSEC(100));
        printk("\n=== Thread Analysis After Init ===\n");
        thread_analyzer_print(0);

        int loop_count = 0;
        while(1) {
            gnss_main_loop();
            k_sleep(K_SECONDS(1));
            printk("%s\n", json_payload);

            // Print thread stats every 60 seconds to monitor ongoing usage
            loop_count++;
            if (loop_count % 60 == 0) {
                printk("\n=== Thread Analysis (runtime) ===\n");
                thread_analyzer_print(0);
            }
        }
    return 0;
}
```

## src/config.c
```c
#include "config.h"
#include <stdio.h>
#include <string.h>
#include <stdlib.h>
#include <zephyr/logging/log.h>
#include <zephyr/logging/log.h>
#include <zephyr/kernel.h>
#include <zephyr/sys/reboot.h>
#include <zephyr/net/socket.h>
#include <zephyr/net/mqtt.h>
#include <zephyr/net/tls_credentials.h>
#include <zephyr/random/random.h>
#include <nrf_modem_at.h>
#include <modem/modem_key_mgmt.h>
#include <zephyr/sys/crc.h>
#include <zephyr/storage/flash_map.h>

LOG_MODULE_REGISTER(configuration, LOG_LEVEL_DBG);
char json_payload[JSON_BUF_SIZE] = "NO PVT";
char sensor_payload[JSON_BUF_SIZE] = "NO SENSOR DATA";
char json_payload_lte[JSON_BUF_SIZE] = "NO LTE";
char json_bmp390[JSON_BUF_SIZE] = "NO BMP390 DATA";
char json_iis2mdc[JSON_BUF_SIZE] = "NO IIS2MDC DATA";
char json_npm1300[JSON_BUF_SIZE_SMALL] = "NO NPM1300 DATA";
char json_icm42688[JSON_BUF_SIZE] = "NO ICM42688 DATA";
char topic_gps[DEFAULT_LEN] = "/gps";
char topic_pwr[DEFAULT_LEN] = "/power";
char topic_sensor[DEFAULT_LEN] = "/sensor";
char topic_lte[DEFAULT_LEN] = "/lte";
char pwd[64] = "Kalscott123";
char usr[64] = "admin";
char firmware_filename[FOTA_FILE_NAME_MAX_LEN] = "firmware.bin";
struct mqtt_utf8 struct_pass;
struct mqtt_utf8 struct_user;
system_enable_t sys_enable_config;
enum fota_state current_state = FOTA_IDLE;
mqtt_config_t mqtt_config;
ota_config_t ota_config;
hardware_info_t hw_info;
modem_info_t modem_info;
sensor_config_t sensor_config;
customer_info_t customer_info;
message_settings_t msg_settings;
bool modem_info_update_needed = false;
K_MUTEX_DEFINE(json_mutex);


gnss_config_t gnss_config = {
    .update_rate = 10,
    .version = "1.0.0",
    .constellation_mask = 0x01,
    .accuracy_threshold = 5
};
```

## src/config.h
```c
#ifndef CONFIG_H
#define CONFIG_H

#include <stdbool.h>
#include <stdint.h>
#include <zephyr/kernel.h>
#include <zephyr/sys/printk.h>
#include <zephyr/logging/log.h>

#include <stdio.h>
#include <stdlib.h>
#include <psa/crypto.h>
#include <psa/crypto_extra.h>
#include <psa/protected_storage.h>
#include <psa/crypto.h>
#include <string.h>
#include <tfm_ns_interface.h>
#define GPS_READ_BUFFER_SIZE 126  
#define GPS_STARTUP_DELAY_MS 2000  
#define GPS_CONFIG_TIMEOUT_MS 500  
#define GPS_MAX_CONFIG_ATTEMPTS 3
#define M10S_ADDR 0x42
#define NAV_PVT_LEN 92

#define MQTT_MAX_STR_LEN 128
#define MQTT_THREAD_STACK_SIZE 2048
#define MQTT_THREAD_PRIORITY 1
#define JSON_BUF_SIZE 300
#define JSON_BUF_SIZE_SMALL 128
#define BAD_PUBLISH_LIMIT 5
#define MQTT_RECONNECT_DELAY_SEC 10


#define MAX_INPUT_LEN 256
#define BLOB_HEADER_SIZE 0
#define ENTRY_SIZE 128

#define MAX_ENTRIES         63
#define MAX_IV_LEN          16
#define MAX_AAD_LEN         64
#define MAX_CIPHERTEXT_LEN  256
#define FLASH_PAGE_SIZE  4096 
#define ENTRIES_PER_PAGE (FLASH_PAGE_SIZE / ENTRY_SIZE)
#define CONFIG_PAGE_COUNT 3  
#define TOTAL_ENTRIES     (CONFIG_PAGE_COUNT * ENTRIES_PER_PAGE) 
#define ENCRYPTED_BLOB_ADDR ((const uint8_t *)0xf8000)
#define ENCRYPTED_BLOB_ADDR_2 ((const uint8_t *)0xfc000)
#define ENCRYPTED_BLOB_SIZE 12288 
#define FLASH_CRC_PAGE_OFFSET (CONFIG_PAGE_COUNT * FLASH_PAGE_SIZE)
#define FLASH_PAGE_CRC_SIZE  (ENCRYPTED_BLOB_SIZE - FLASH_CRC_PAGE_OFFSET)
#define CRC_LOCATION_OFFSET (ENCRYPTED_BLOB_SIZE - 4)


#define PROVISIONING_SUCCESS            (0)
#define PROVISIONING_ERROR_CRYPTO_INIT  (-100)
#define PROVISIONING_ERROR_KEY_IMPORT   (-101)
#define PROVISIONING_ERROR_KEY_OPEN     (-102)
#define PROVISIONING_ERROR_ENCRYPT      (-103)
#define PROVISIONING_ERROR_DECRYPT      (-104)
#define PROVISIONING_ERROR_IV_GEN       (-105)
#define PROVISIONING_ERROR_VERIFICATION (-106)
#define PROVISIONING_ERROR_KEY_DESTROY  (-107)
#define PROVISIONING_ERROR_BUFFER_SIZE  (-108)

#define NRF_CRYPTO_EXAMPLE_AES_MAX_TEXT_SIZE (100)
#define NRF_CRYPTO_EXAMPLE_AES_BLOCK_SIZE (16)
#define NRF_CRYPTO_EXAMPLE_AES_IV_SIZE (12)
#define NRF_CRYPTO_EXAMPLE_AES_ADDITIONAL_SIZE (35)
#define NRF_CRYPTO_EXAMPLE_AES_GCM_TAG_LENGTH (16)
#define AES_KEY_SIZE (32) 
#define DECRYPTED_OUTPUT_MAX 256

// MODEM INFO
#define LTE_DATA_INTERVAL  K_SECONDS(60)  
#define LTE_BUF_LEN 32

#define MAX_TRIES        3
#define LOCKOUT_MS       30000     
#define AUTO_LOGOUT_MS   60000      

#define MAX_BLOB (8 * 1024) 
#define PBKDF2_ITERATIONS 64000u

#define FOTA_FILE_NAME_MAX_LEN 300
#define DEFAULT_LEN 64
extern char firmware_filename[FOTA_FILE_NAME_MAX_LEN];
extern char json_payload[JSON_BUF_SIZE];
extern char sensor_payload[JSON_BUF_SIZE];
extern char json_npm1300[JSON_BUF_SIZE_SMALL];
extern char json_payload_lte[JSON_BUF_SIZE];
extern char topic_gps[DEFAULT_LEN];
extern char topic_sensor[DEFAULT_LEN];
extern char topic_lte[DEFAULT_LEN];
extern char topic_pwr[DEFAULT_LEN];
extern char json_bmp390[JSON_BUF_SIZE];
extern char json_iis2mdc[JSON_BUF_SIZE];
extern char json_icm42688[JSON_BUF_SIZE];
extern struct mqtt_utf8 struct_pass;
extern struct mqtt_utf8 struct_user;
extern struct k_work fota_work;
extern bool modem_info_update_needed;

typedef struct {
    bool lte_en;
    bool irid_en;
    bool psm_en;
    bool hw_en;
    bool mdm_en;
    bool gnss_en;
    bool imu_en;
    bool comp_en;
    bool baro_en;
    bool mqtt_en;
    bool ota_en;
    bool debug_mode;
    bool factory_mode;

} system_enable_t;

extern system_enable_t sys_enable_config;
#define SYS_EN_LTE_EN        (1 << 0)
#define SYS_EN_IRID_EN       (1 << 1)
#define SYS_EN_PSM_EN        (1 << 2)
#define SYS_EN_HW_EN         (1 << 3)
#define SYS_EN_MDM_EN        (1 << 4)
#define SYS_EN_GNSS_EN       (1 << 5)
#define SYS_EN_IMU_EN        (1 << 6)
#define SYS_EN_COMP_EN       (1 << 7)
#define SYS_EN_BARO_EN       (1 << 8)
#define SYS_EN_MQTT_EN       (1 << 9)
#define SYS_EN_OTA_EN        (1 << 10)
#define SYS_EN_DEBUG_MODE    (1 << 11)
#define SYS_EN_FACTORY_MODE  (1 << 12)

typedef struct {
    int publish_rate;
    char broker_addr[64];
    int broker_port;
    char client_id[64];
    char username[64];
    char password[64];
    bool tls_enabled;
    int qos;
} mqtt_config_t;


typedef struct {
    int check_interval;
    char server_addr[64];
    int server_port;
    char username[64];
    char password[64];
    bool tls_enabled;
    char cert_tag[64];
} ota_config_t;


typedef struct {
    char sn[32];
    char hw_ver[16];    
    char fw_ver[16];   
    bool power_enabled; 
} hardware_info_t;

typedef struct {
    char make[32];   
    char model[32]; 
    char fw_ver[16];    
    char imei[20];    
    char sim[32];    
    char esim[32];      
    char pdn[64];
    uint16_t lte_bandmask;
} modem_info_t;

typedef struct {
    int  sampling_rate;     
    int  filter_window;     
    bool auto_calibrate;  
} sensor_config_t;

typedef struct {
    int update_rate;
    char version[32];
    uint8_t constellation_mask;
    int accuracy_threshold;
} gnss_config_t;

typedef struct {
    char uas_num[32];
    char description[64];
    char uas_status[64];
    char field2[64];
    char field3[64];
    char field4[64];
} customer_info_t;

typedef struct {
    char msg_format[16];  
    char gps_format[16];   
    char units[16];       
} message_settings_t;

typedef struct {
    uint8_t iv[MAX_IV_LEN];
    uint8_t iv_len;

    uint8_t aad[MAX_AAD_LEN];
    uint16_t aad_len;

    uint8_t ciphertext[MAX_CIPHERTEXT_LEN];
    uint16_t ciphertext_len;

    uint32_t mem_offset;  
} ConfigEntry;


extern ConfigEntry entries[MAX_ENTRIES];
extern int num_entries;

extern mqtt_config_t mqtt_config;
extern ota_config_t ota_config;
extern hardware_info_t hw_info;
extern modem_info_t modem_info;
extern sensor_config_t sensor_config;
extern gnss_config_t gnss_config;
extern customer_info_t customer_info;
extern message_settings_t message_settings;

void parse_encrypted_blob(void);
const char *get_config(const char *aad);
void config_init(void);
uint32_t manual_crc32(const uint8_t *data, size_t len);
int update_crc(void);

enum fota_state {
    FOTA_IDLE,
    FOTA_CONNECTED,
    FOTA_DOWNLOADING,
    FOTA_READY_TO_APPLY,
    FOTA_APPLYING,
};


#endif // CONFIG_H
```

## src/gnss.h
```c
#ifndef GNSS_H
#define GNSS_H

#define I2C_NODE DT_NODELABEL(i2c2)
#define QWIIC_EN_NODE DT_ALIAS(qwiic_en)


extern const struct device *i2c_dev;


struct __attribute__((packed)) ubx_nav_pvt_t {
    uint32_t iTOW;
    uint16_t year;
    uint8_t month;
    uint8_t day;
    uint8_t hour;
    uint8_t min;
    uint8_t sec;
    uint8_t valid;
    uint32_t tAcc;
    int32_t nano;
    uint8_t fixType;
    uint8_t flags;
    uint8_t flags2;
    uint8_t numSV;
    int32_t lon;
    int32_t lat;
    int32_t height;
    int32_t hMSL;
    uint32_t hAcc;
    uint32_t vAcc;
    int32_t velN;
    int32_t velE;
    int32_t velD;
    int32_t gSpeed;
    int32_t heading;
    uint32_t sAcc;
    uint32_t headingAcc;
    uint16_t pDOP;
    uint8_t reserved[6];
    int32_t headVeh;
    int16_t magDec;
    uint16_t magAcc;
};


bool validate_gps_fix(const struct ubx_nav_pvt_t *pvt); 

void ubx_checksum(const uint8_t *data, size_t len, uint8_t *ck_a, uint8_t *ck_b);

void print_nav_pvt_json(const struct ubx_nav_pvt_t *pvt);

bool parse_nav_pvt(const uint8_t *buf, size_t len, struct ubx_nav_pvt_t *out);

int parse_ack(const uint8_t *buf, size_t len, uint8_t cls, uint8_t id);

bool send_ubx_message(uint8_t *msg, size_t len, const char *desc);

bool configure_gps_10hz(void);

bool configure_constellation(void);

void gnss_main_loop();
void gnss_int();

void test_configure(uint8_t *msg);
bool parse_constellation_val_get(const uint8_t *buf, size_t len);
bool set_gps_only(void);
extern struct k_mutex json_mutex;


#define RAM_LAYER 0x00

#define SIGNAL_ON 0x01
#define SIGNAL_OFF 0x00

#define GPS_MAX_SPEED_MPS 100.0
#define GPS_MAX_LAT_JUMP 5000000
#define GPS_MAX_LON_JUMP 5000000
#define GPS_MAX_TIME_BACKWARDS_MS 100

#define GPS_EN 0x1031001f
#define GPS_L1CA_ENA 0x10310001

#define SBAS_ENA 0x10310020
#define SBAS_L1CA_ENA 0x10310005

#define GAL_ENA 0x10310021
#define GAL_E1B_ENA 0x10310007

#define BDS_ENA 0x10310022
#define BDS_B1_ENA 0x1031000d
#define BDS_B1C_ENA 0x1031000f

#define QZSS_ENA 0x10310024
#define QZSS_L1CA_ENA 0x10310012
#define QZSS_L1BC_ENA 0x10310039
#define QZSS_L1S_ENA 0x10310014

#define GLO_ENA 0x10310025
#define GLO_L1_ENA 0x10310018

#define NAVIC_ENA 0x10310026


#endif
```

## src/npm1300_startup.c
```c
#include <zephyr/kernel.h>
#include <zephyr/device.h>
#include <zephyr/drivers/i2c.h>
#include <zephyr/shell/shell.h>
#include <zephyr/logging/log.h>
#include <math.h>
#include <stdio.h>
#include "config.h"

LOG_MODULE_REGISTER(npm1300_ctrl, LOG_LEVEL_INF);

/* -------------------------------------------------------------------------- */
/* nPM1300 I2C and Register Definitions                                       */
/* -------------------------------------------------------------------------- */

#define NPM1300_I2C_ADDR        0x6B
#define NPM1300_I2C_DEV         DT_NODELABEL(i2c2)


#define BAT_TEMP_CONF_REG_MSB   0x03
#define BAT_TEMP_CONF_REG_LSB   0x06
#define TEMP_MONITOR_DISABLE    0x02
#define TEMP_MONITOR_ENABLE     0x00

#define BCHGISE_BASE 0x03
#define BCHGISETDISCHARGE_MSB  0x0A
#define BCHGISETDISCHARGE_MSB_FULL 0x030A
#define BCHGISETDISCHARGE_LSB   0x0B
#define BCHGISETDISCHARGE_LSB_FULL 0x030B

#define BCHGISETCHARGE_MSB  0x08
#define BCHGISETCHARGE_MSB_FULL 0x0308
#define BCHGISETCHARGE_LSB      0x09
#define BCHGISETCHARGE_LSB_FULL 0x0309

#define BCHARGER_BASE 0x05
#define BCHARGER_MODE 0x10
#define BCHARGER_MODE_FULL 0x0510

#define BCHARGER_MODE_BITMASK 0b00001000


#define BCHGISETCHARGE_MSB_VALUE 0x26
#define BCHGISETCHARGE_LSB_VALUE 0x00

#define TASK_VBAT_MEASURE          0x0500
#define TASK_NTC_MEASURE           0x0501
#define TASK_TEMP_MEASURE          0x0502
#define TASK_VSYS_MEASURE          0x0503
#define TASK_IBAT_MEASURE          0x0506
#define TASK_VBUS_MEASURE          0x0507
#define TASK_DELAYED_VBAT_MEASURE  0x0508


#define ADC_IBAT_STATUS_MSB  0x0510
#define ADC_IBAT_STATUS_LSB  0x0511
#define ADC_VBAT_MSB         0x0511
#define ADC_NTC_MSB          0x0512
#define ADC_TEMP_MSB         0x0513
#define ADC_VSYS_MSB         0x0514
#define ADC_GP0_LSB          0x0515
#define ADC_VBUS_MSB         0x0519
#define ADC_GP1_LSB          0x051A

#define VFS_VBAT 5.0f
#define VFS_VSYS 6.375f
#define VFS_VBUS 7.0f
#define IFS_IBAT_HEAD_ROOM_DISCHARGE 1.12f
#define IFS_IBAT_HEAD_ROOM_CHARGE 1.25f

#define IBAT_LSB_A 0.00015625f   
#define TEMP_LSB_C 0.125f
#define TEMP_OFFSET_C -40.0f

#define BETA_NTC   3435.0f
#define T0_K       298.15f

static const struct device *i2c_dev = DEVICE_DT_GET(DT_NODELABEL(i2c2));
static struct k_work_delayable npm1300_work;

/* -------------------------------------------------------------------------- */
/* Utility Helpers                                                            */
/* -------------------------------------------------------------------------- */

static int npm1300_write_reg16(const struct device *i2c_dev,
                               uint8_t msb, uint8_t lsb, uint8_t val)
{
    uint8_t tx_buf[3] = { msb, lsb, val };
    return i2c_write(i2c_dev, tx_buf, sizeof(tx_buf), NPM1300_I2C_ADDR);
}


static int npm1300_write_task(uint16_t reg)
{
    uint8_t addr[2] = {
        (uint8_t)((reg >> 8) & 0xFF),
        (uint8_t)(reg & 0xFF)
    };
    uint8_t val = 0x01;
    uint8_t tx[3] = { addr[0], addr[1], val };
    return i2c_write(i2c_dev, tx, sizeof(tx), NPM1300_I2C_ADDR);
}


static int npm1300_read8(uint16_t reg, uint8_t *out)
{
    uint8_t addr[2] = {
        (uint8_t)((reg >> 8) & 0xFF),
        (uint8_t)(reg & 0xFF)
    };
    return i2c_write_read(i2c_dev, NPM1300_I2C_ADDR,
                          addr, sizeof(addr), out, 1);
}


static int npm1300_read16(uint16_t reg_msb, uint16_t reg_lsb, uint16_t *out)
{
    uint8_t addr_msb[2] = { (reg_msb >> 8) & 0xFF, reg_msb & 0xFF };
    uint8_t addr_lsb[2] = { (reg_lsb >> 8) & 0xFF, reg_lsb & 0xFF };
    uint8_t msb, lsb;

    if (i2c_write_read(i2c_dev, NPM1300_I2C_ADDR, addr_msb, 2, &msb, 1) < 0) return -1;
    if (i2c_write_read(i2c_dev, NPM1300_I2C_ADDR, addr_lsb, 2, &lsb, 1) < 0) return -1;

    *out = ((uint16_t)msb << 8) | lsb;
    return 0;
}


static float calc_tbat_c(uint16_t raw_ntc)
{
    if (raw_ntc == 0 || raw_ntc >= 1024) return 0.0f;
    float tbat_k = 1.0f / ((1.0f / T0_K) -
                   (1.0f / BETA_NTC) * logf((1024.0f / raw_ntc) - 1.0f));
    return tbat_k - 273.15f;
}

/* -------------------------------------------------------------------------- */
/* Temperature-monitor control                                                */
/* -------------------------------------------------------------------------- */

static int npm1300_disable_temp_monitor(void)
{
    if (!device_is_ready(i2c_dev)) return -ENODEV;
    int ret = npm1300_write_reg16(i2c_dev,
                                  BAT_TEMP_CONF_REG_MSB,
                                  BAT_TEMP_CONF_REG_LSB,
                                  TEMP_MONITOR_DISABLE);
    if (ret == 0)
        LOG_INF("NPM1300 temperature monitoring disabled");
    else
        LOG_WRN("Failed to disable temp monitor: %d", ret);
    return ret;
}

static int npm1300_enable_temp_monitor(void)
{
    if (!device_is_ready(i2c_dev)) return -ENODEV;
    int ret = npm1300_write_reg16(i2c_dev,
                                  BAT_TEMP_CONF_REG_MSB,
                                  BAT_TEMP_CONF_REG_LSB,
                                  TEMP_MONITOR_ENABLE);
    if (ret == 0)
        LOG_INF("NPM1300 temperature monitoring re-enabled");
    else
        LOG_WRN("Failed to enable temp monitor: %d", ret);
    return ret;
}

static int npm1300_temp_monitor_init(void)
{
    return npm1300_disable_temp_monitor();
}

/* -------------------------------------------------------------------------- */
/* ADC Read Workqueue                                                         */
/* -------------------------------------------------------------------------- */

static void npm1300_read_work(struct k_work *work)
{
    uint8_t vbat_m=0, ntc_m=0, temp_m=0, vsys_m=0, vbus_m=0;
    uint8_t gp0_lsb=0, gp1_lsb=0;
    uint16_t raw_vbat=0, raw_ntc=0, raw_temp=0, raw_vsys=0, raw_vbus=0;

    if (!device_is_ready(i2c_dev)) {
        LOG_ERR("I2C device not ready in work handler");
        k_work_schedule(&npm1300_work, K_SECONDS(30));
        return;
    }

    npm1300_write_task(TASK_VBAT_MEASURE);
    k_msleep(10);
    npm1300_read8(ADC_VBAT_MSB, &vbat_m);

    npm1300_write_task(TASK_NTC_MEASURE);
    k_msleep(10);
    npm1300_read8(ADC_NTC_MSB, &ntc_m);

    npm1300_write_task(TASK_TEMP_MEASURE);
    k_msleep(10);
    npm1300_read8(ADC_TEMP_MSB, &temp_m);

    npm1300_write_task(TASK_VSYS_MEASURE);
    k_msleep(10);
    npm1300_read8(ADC_VSYS_MSB, &vsys_m);

    npm1300_read8(ADC_GP0_LSB, &gp0_lsb);

    npm1300_write_task(TASK_VBUS_MEASURE);
    k_msleep(10);
    npm1300_read8(ADC_VBUS_MSB, &vbus_m);
    npm1300_read8(ADC_GP1_LSB, &gp1_lsb);

    npm1300_write_task(TASK_IBAT_MEASURE);
    k_msleep(10);
    uint16_t raw_ibat_u16 = 0;
    npm1300_read16(ADC_IBAT_STATUS_MSB, ADC_IBAT_STATUS_LSB, &raw_ibat_u16);
    int16_t raw_ibat = (int16_t)raw_ibat_u16;
    
    raw_vbat = ((uint16_t)vbat_m << 2) | ((gp0_lsb >> 0) & 0x03);
    raw_ntc  = ((uint16_t)ntc_m  << 2) | ((gp0_lsb >> 2) & 0x03);
    raw_temp = ((uint16_t)temp_m << 2) | ((gp0_lsb >> 4) & 0x03);
    raw_vsys = ((uint16_t)vsys_m << 2) | ((gp0_lsb >> 6) & 0x03);
    raw_vbus = ((uint16_t)vbus_m << 2) | ((gp1_lsb >> 0) & 0x03);
    uint8_t charge_mode=0;

    npm1300_read8(BCHARGER_MODE_FULL, &charge_mode);

    uint8_t raw_battery_charge_msb = 0;
    uint8_t raw_battery_charge_lsb = 0;
    float raw_battery_charge_total = 0.0;
    float ibat_fs = 0.0;
    uint8_t after_mask = charge_mode & BCHARGER_MODE_BITMASK;
    if (after_mask > 0) {
        npm1300_read8(BCHGISETCHARGE_MSB_FULL, &raw_battery_charge_msb);
        npm1300_read8(BCHGISETCHARGE_LSB_FULL, &raw_battery_charge_lsb);
        raw_battery_charge_total = (float)raw_battery_charge_msb*4.0f + (float)raw_battery_charge_lsb*2.0f;
        ibat_fs = raw_battery_charge_total * IFS_IBAT_HEAD_ROOM_CHARGE;
    }
    else {
        npm1300_read8(BCHGISETDISCHARGE_MSB_FULL, &raw_battery_charge_msb);
        npm1300_read8(BCHGISETDISCHARGE_LSB_FULL, &raw_battery_charge_lsb);
        raw_battery_charge_total = (float)raw_battery_charge_msb*4.8f + (float)raw_battery_charge_lsb*2.4f;
        ibat_fs = raw_battery_charge_total * IFS_IBAT_HEAD_ROOM_DISCHARGE;
    }

    double ibat_a = ((float)raw_ibat / (float)3.2768e4) * ibat_fs;





    double vbat_v = ((double)raw_vbat / 1024.0) * (double)VFS_VBAT;
    double vsys_v = ((double)raw_vsys / 1024.0) * (double)VFS_VSYS;
    double vbus_v = ((double)raw_vbus / 1024.0) * (double)VFS_VBUS;
    double tbat_c = calc_tbat_c(raw_ntc);
    double temp_die_c = 394.67f - (0.7926f * raw_temp);

    snprintf(json_npm1300, sizeof(json_npm1300),
             "{\"vbat_v\":%.3f,\"vsys_v\":%.3f,\"vbus_v\":%.3f,"
             "\"ibat_a\":%.3f,\"temp_die_c\":%.1f,\"tbat_c\":%.1f}",
             vbat_v, vsys_v, vbus_v, ibat_a, temp_die_c, tbat_c);

    LOG_INF("%s", json_npm1300);
    k_work_schedule(&npm1300_work, K_SECONDS(30));
}

/* -------------------------------------------------------------------------- */
/* Initialization                                                             */
/* -------------------------------------------------------------------------- */

static int npm1300_init(void)
{
    if (!device_is_ready(i2c_dev)) {
        LOG_ERR("I2C device not ready");
        return -ENODEV;
    }
    k_work_init_delayable(&npm1300_work, npm1300_read_work);
    k_work_schedule(&npm1300_work, K_NO_WAIT);
    return 0;
}

/* -------------------------------------------------------------------------- */
/* Shell Commands                                                             */
/* -------------------------------------------------------------------------- */

static int cmd_npm1300_disable_temp(const struct shell *shell,
                                    size_t argc, char **argv)
{
    int ret = npm1300_disable_temp_monitor();
    shell_print(shell, (ret == 0) ? "Temperature monitoring disabled" :
                                   "Disable failed: %d", ret);
    return ret;
}

static int cmd_npm1300_enable_temp(const struct shell *shell,
                                   size_t argc, char **argv)
{
    int ret = npm1300_enable_temp_monitor();
    shell_print(shell, (ret == 0) ? "Temperature monitoring enabled" :
                                   "Enable failed: %d", ret);
    return ret;
}

SHELL_CMD_REGISTER(disable_npm1300_temp, NULL,
                   "Disable temperature monitoring on NPM1300 PMIC",
                   cmd_npm1300_disable_temp);

SHELL_CMD_REGISTER(enable_npm1300_temp, NULL,
                   "Re-enable temperature monitoring on NPM1300 PMIC",
                   cmd_npm1300_enable_temp);

/* -------------------------------------------------------------------------- */

SYS_INIT(npm1300_init, APPLICATION, 3);
SYS_INIT(npm1300_temp_monitor_init, APPLICATION, 1);


static int npm1300_change_bat_current(void)
{
    if (!device_is_ready(i2c_dev)) return -ENODEV;

    int ret = 0;
    uint8_t config[3] = {BCHGISE_BASE,BCHGISETCHARGE_MSB,BCHGISETCHARGE_MSB_VALUE};
    ret = i2c_write(i2c_dev, config, sizeof(config), NPM1300_I2C_ADDR);
    if (ret < 0) {
        LOG_ERR("Failed to write BCHGISETDISCHARGE_MSB: %d", ret);
        return ret;
    }
    config[1] = BCHGISETCHARGE_LSB;
    config[0] = BCHGISETCHARGE_LSB_VALUE;

    ret = i2c_write(i2c_dev, config, sizeof(config), NPM1300_I2C_ADDR);
    if (ret < 0) {
        LOG_ERR("Failed to write BCHGISETCHARGE_LSB: %d", ret);
        return ret;
    }
    LOG_INF("NPM1300 battery current limits modified");
    return 0;

}

SYS_INIT(npm1300_change_bat_current, APPLICATION, 2);
```
