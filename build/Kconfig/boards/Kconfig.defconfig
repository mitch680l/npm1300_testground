## build/Kconfig/boards/Kconfig.defconfig
```kconfig
# Load Zephyr board defconfig descriptions.
osource "C:/npm1300_testground/npm1300_test/boards/KalScott/Kconfig.defconfig"
```

## build/Kconfig/boards/Kconfig.kestrel
```kconfig
# Load board Kconfig descriptions.
osource "C:/npm1300_testground/npm1300_test/boards/KalScott/Kconfig.kestrel"
```

## build/npm1300_testground/Kconfig/Kconfig.shield
```kconfig
osource "C:/kes_new_features/npm1300_testground/boards/shields/*/Kconfig.shield"
osource "C:/ncs/v3.0.2/nrf/boards/shields/*/Kconfig.shield"
```

## build/npm1300_testground/Kconfig/boards/Kconfig.defconfig
```kconfig
# Load Zephyr board defconfig descriptions.
osource "C:/kes_new_features/npm1300_testground/boards/KalScott/Kconfig.defconfig"
```

## build/npm1300_testground/Kconfig/boards/Kconfig.sysbuild
```kconfig
# Load Sysbuild board Kconfig descriptions.
osource "C:/kes_new_features/npm1300_testground/boards/KalScott/Kconfig.sysbuild"
```

## npm1300_test/build/Kconfig/Kconfig.shield
```kconfig
osource "C:/npm1300_testground/npm1300_test/boards/shields/*/Kconfig.shield"
osource "C:/ncs/v3.0.2/nrf/boards/shields/*/Kconfig.shield"
```
